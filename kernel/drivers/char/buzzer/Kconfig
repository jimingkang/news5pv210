## kernel/drivers/char/buzzer/Kconfig
```kconfig
config X210_BUZZER_DRIVER
	bool "x210 buzzer driver"
	default y
	help
	compile for buzzer driver,y for kernel,m for module.
```

## x210ii_kernel/drivers/char/led/Kconfig
```kconfig
config X210_LED_DRIVER
	bool "x210 led driver"
	default y
	help
	compile for leddriver,y for kernel,m for module.
```
